## app/boards/our_board/board.yml
```yaml
board:
  name: our_board
  full_name: Nucleo F429ZI
  vendor: custom
  socs:
    - name: stm32f429xx
```

## dts/bindings/sarche_driver.yaml
```yaml
description: LED driver just for fun
compatible: "sarche,driver"
include: base.yaml
```

## tests/calculator/testcase.yaml
```yaml
common:
  tags:
    - unit
    - calculator
    - ztest

tests:
  example.unit.calculator:
    tags:
      - unit
      - calculator
      - ztest
    platform_allow:
      - native_sim
    timeout: 60
```

## twister-out.14/native_sim_native/host_gnu/zephyr-course/tests/ring_buf/homework.unit.ring_buf/Kconfig/arch/Kconfig
```kconfig
# Load Zephyr Arch Kconfig descriptions.
osource "/home/felipe/zephyrproject/zephyr/arch/rx/Kconfig"
osource "/home/felipe/zephyrproject/zephyr/arch/x86/Kconfig"
osource "/home/felipe/zephyrproject/zephyr/arch/xtensa/Kconfig"
osource "/home/felipe/zephyrproject/zephyr/arch/sparc/Kconfig"
osource "/home/felipe/zephyrproject/zephyr/arch/riscv/Kconfig"
osource "/home/felipe/zephyrproject/zephyr/arch/posix/Kconfig"
osource "/home/felipe/zephyrproject/zephyr/arch/openrisc/Kconfig"
osource "/home/felipe/zephyrproject/zephyr/arch/mips/Kconfig"
osource "/home/felipe/zephyrproject/zephyr/arch/arm64/Kconfig"
osource "/home/felipe/zephyrproject/zephyr/arch/arm/Kconfig"
osource "/home/felipe/zephyrproject/zephyr/arch/arc/Kconfig"
```

## twister-out.22/native_sim_native/host_gnu/zephyr-course/tests/ring_buf/homework.unit.ring_buf/Kconfig/boards/Kconfig
```kconfig
# Load Zephyr board Kconfig descriptions.
osource "/home/felipe/zephyrproject/zephyr/boards/native/native_sim/Kconfig"
```

## twister-out.23/native_sim_native/host_gnu/zephyr-course/tests/ring_buf/homework.unit.ring_buf/Kconfig/boards/Kconfig.sysbuild
```kconfig
# Load Sysbuild board Kconfig descriptions.
osource "/home/felipe/zephyrproject/zephyr/boards/native/native_sim/Kconfig.sysbuild"
```

## twister-out.32/native_sim_native/host_gnu/zephyr-course/tests/ring_buf/homework.unit.ring_buf/Kconfig/boards/Kconfig.defconfig.tmp
```kconfig
# Load Zephyr board defconfig descriptions.
osource "/home/felipe/zephyrproject/zephyr/boards/native/native_sim/Kconfig.defconfig"
```
